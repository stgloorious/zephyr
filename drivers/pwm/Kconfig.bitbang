## drivers/pwm/Kconfig.bitbang
```kconfig
# SPDX-FileCopyrightText: Copyright (c) 2026 Siemens AG
# SPDX-License-Identifier: Apache-2.0

config PWM_BITBANG
        bool "Bitbang PWM driver"
        default y
        depends on DT_HAS_ZEPHYR_BITBANG_PWM_ENABLED
        depends on GPIO
        help
          Generic software-based PWM driver using hardware timer interrupts.
          Use this as a fallback only if you don't have dedicated hardware PWM
          pins left and understand the CPU overhead implications.
          The period is the same for all channels.
```

## tests/drivers/led/trigger/testcase.yaml
```yaml
tests:
  drivers.led.trigger:
    tags:
      - drivers
      - led
    harness: ztest
    platform_allow: native_sim
    integration_platforms:
      - native_sim
```
